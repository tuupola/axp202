## Kconfig
```kconfig
menu "Power system configuration (AXP202)"

menu "Output control"
    config AXP202_DCDC23_LDO234_EXTEN_CONTROL_BIT6_SELECTED
        bool "Enable LDO3"
    config AXP202_DCDC23_LDO234_EXTEN_CONTROL_BIT4_SELECTED
        bool "Enable DC-DC2"
    config AXP202_DCDC23_LDO234_EXTEN_CONTROL_BIT3_SELECTED
        bool "Enable LDO4"
    config AXP202_DCDC23_LDO234_EXTEN_CONTROL_BIT2_SELECTED
        bool "Enable LDO2"
    config AXP202_DCDC23_LDO234_EXTEN_CONTROL_BIT1_SELECTED
        bool "Enable DC-DC3"
    config AXP202_DCDC23_LDO234_EXTEN_CONTROL_BIT0_SELECTED
        bool "Enable EXTEN"
endmenu

config AXP202_DCDC23_LDO234_EXTEN_CONTROL_BIT6
    hex
    default 0x00 if !AXP202_DCDC23_LDO234_EXTEN_CONTROL_BIT6_SELECTED
    default 0x40 if AXP202_DCDC23_LDO234_EXTEN_CONTROL_BIT6_SELECTED

config AXP202_DCDC23_LDO234_EXTEN_CONTROL_BIT4
    hex
    default 0x00 if !AXP202_DCDC23_LDO234_EXTEN_CONTROL_BIT4_SELECTED
    default 0x10 if AXP202_DCDC23_LDO234_EXTEN_CONTROL_BIT4_SELECTED

config AXP202_DCDC23_LDO234_EXTEN_CONTROL_BIT3
    hex
    default 0x00 if !AXP202_DCDC23_LDO234_EXTEN_CONTROL_BIT3_SELECTED
    default 0x08 if AXP202_DCDC23_LDO234_EXTEN_CONTROL_BIT3_SELECTED

config AXP202_DCDC23_LDO234_EXTEN_CONTROL_BIT2
    hex
    default 0x00 if !AXP202_DCDC23_LDO234_EXTEN_CONTROL_BIT2_SELECTED
    default 0x04 if AXP202_DCDC23_LDO234_EXTEN_CONTROL_BIT2_SELECTED

config AXP202_DCDC23_LDO234_EXTEN_CONTROL_BIT1
    hex
    default 0x00 if !AXP202_DCDC23_LDO234_EXTEN_CONTROL_BIT1_SELECTED
    default 0x02 if AXP202_DCDC23_LDO234_EXTEN_CONTROL_BIT1_SELECTED

config AXP202_DCDC23_LDO234_EXTEN_CONTROL_BIT0
    hex
    default 0x00 if !AXP202_DCDC23_LDO234_EXTEN_CONTROL_BIT0_SELECTED
    default 0x01 if AXP202_DCDC23_LDO234_EXTEN_CONTROL_BIT0_SELECTED


menu "Output voltage"

    choice AXP202_DCDC2_VOLTAGE_BIT50
        prompt "DC-DC2 output voltage"
        default AXP202_DCDC2_VOLTAGE_BIT50_1V8

        config AXP202_DCDC2_VOLTAGE_BIT50_0V7
            bool "0.7V"
        config AXP202_DCDC2_VOLTAGE_BIT50_0V8
            bool "0.8V"
        config AXP202_DCDC2_VOLTAGE_BIT50_0V9
            bool "0.9V"
        config AXP202_DCDC2_VOLTAGE_BIT50_1V0
            bool "1.0V"
        config AXP202_DCDC2_VOLTAGE_BIT50_1V1
            bool "1.1V"
        config AXP202_DCDC2_VOLTAGE_BIT50_1V2
            bool "1.2V"
        config AXP202_DCDC2_VOLTAGE_BIT50_1V3
            bool "1.3V"
        config AXP202_DCDC2_VOLTAGE_BIT50_1V4
            bool "1.4V"
        config AXP202_DCDC2_VOLTAGE_BIT50_1V5
            bool "1.5V"
        config AXP202_DCDC2_VOLTAGE_BIT50_1V6
            bool "1.6V"
        config AXP202_DCDC2_VOLTAGE_BIT50_1V7
            bool "1.7V"
        config AXP202_DCDC2_VOLTAGE_BIT50_1V8
            bool "1.8V"
        config AXP202_DCDC2_VOLTAGE_BIT50_1V9
            bool "1.9V"
        config AXP202_DCDC2_VOLTAGE_BIT50_2V0
            bool "2.0V"
        config AXP202_DCDC2_VOLTAGE_BIT50_2V1
            bool "2.1V"
        config AXP202_DCDC2_VOLTAGE_BIT50_2V2
            bool "2.2V"
        config AXP202_DCDC2_VOLTAGE_BIT50_2V3
            bool "2.3V"
        config AXP202_DCDC2_VOLTAGE_BIT50_2V3
            bool "2.4V"
        config AXP202_DCDC2_VOLTAGE_BIT50_2V4
            bool "2.5V"
        config AXP202_DCDC2_VOLTAGE_BIT50_2V5
            bool "2.6V"
        config AXP202_DCDC2_VOLTAGE_BIT50_2V6
            bool "2.6V"
        config AXP202_DCDC2_VOLTAGE_BIT50_2V7
            bool "2.7V"
    endchoice

    config AXP202_DCDC2_VOLTAGE_BIT50
        hex
        default 0x00 if AXP202_DCDC2_VOLTAGE_BIT50_0V7
        default 0x04 if AXP202_DCDC2_VOLTAGE_BIT50_0V8
        default 0x08 if AXP202_DCDC2_VOLTAGE_BIT50_0V9
        default 0x0c if AXP202_DCDC2_VOLTAGE_BIT50_1V0
        default 0x10 if AXP202_DCDC2_VOLTAGE_BIT50_1V1
        default 0x14 if AXP202_DCDC2_VOLTAGE_BIT50_1V2
        default 0x18 if AXP202_DCDC2_VOLTAGE_BIT50_1V3
        default 0x1c if AXP202_DCDC2_VOLTAGE_BIT50_1V4
        default 0x20 if AXP202_DCDC2_VOLTAGE_BIT50_1V5
        default 0x24 if AXP202_DCDC2_VOLTAGE_BIT50_1V6
        default 0x28 if AXP202_DCDC2_VOLTAGE_BIT50_1V7
        default 0x2c if AXP202_DCDC2_VOLTAGE_BIT50_1V8
        default 0x30 if AXP202_DCDC2_VOLTAGE_BIT50_1V9
        default 0x34 if AXP202_DCDC2_VOLTAGE_BIT50_2V0
        default 0x38 if AXP202_DCDC2_VOLTAGE_BIT50_2V1
        default 0x3c if AXP202_DCDC2_VOLTAGE_BIT50_2V2
        default 0x40 if AXP202_DCDC2_VOLTAGE_BIT50_2V3
        default 0x44 if AXP202_DCDC2_VOLTAGE_BIT50_2V4
        default 0x48 if AXP202_DCDC2_VOLTAGE_BIT50_2V5
        default 0x4c if AXP202_DCDC2_VOLTAGE_BIT50_2V6
        default 0x50 if AXP202_DCDC2_VOLTAGE_BIT50_2V7

    choice AXP202_DCDC3_VOLTAGE_BIT60
        prompt "DC-DC3 output voltage"
        default AXP202_DCDC3_VOLTAGE_BIT60_3V0
        config AXP202_DCDC3_VOLTAGE_BIT60_0V7
            bool "0.7V"
        config AXP202_DCDC3_VOLTAGE_BIT60_0V8
            bool "0.8V"
        config AXP202_DCDC3_VOLTAGE_BIT60_0V9
            bool "0.9V"
        config AXP202_DCDC3_VOLTAGE_BIT60_1V0
            bool "1.0V"
        config AXP202_DCDC3_VOLTAGE_BIT60_1V1
            bool "1.1V"
        config AXP202_DCDC3_VOLTAGE_BIT60_1V2
            bool "1.2V"
        config AXP202_DCDC3_VOLTAGE_BIT60_1V3
            bool "1.3V"
        config AXP202_DCDC3_VOLTAGE_BIT60_1V4
            bool "1.4V"
        config AXP202_DCDC3_VOLTAGE_BIT60_1V5
            bool "1.5V"
        config AXP202_DCDC3_VOLTAGE_BIT60_1V6
            bool "1.6V"
        config AXP202_DCDC3_VOLTAGE_BIT60_1V7
            bool "1.7V"
        config AXP202_DCDC3_VOLTAGE_BIT60_1V8
            bool "1.8V"
        config AXP202_DCDC3_VOLTAGE_BIT60_1V9
            bool "1.9V"
        config AXP202_DCDC3_VOLTAGE_BIT60_2V0
            bool "2.0V"
        config AXP202_DCDC3_VOLTAGE_BIT60_2V1
            bool "2.1V"
        config AXP202_DCDC3_VOLTAGE_BIT60_2V2
            bool "2.2V"
        config AXP202_DCDC3_VOLTAGE_BIT60_2V3
            bool "2.3V"
        config AXP202_DCDC3_VOLTAGE_BIT60_2V3
            bool "2.4V"
        config AXP202_DCDC3_VOLTAGE_BIT60_2V4
            bool "2.5V"
        config AXP202_DCDC3_VOLTAGE_BIT60_2V5
            bool "2.6V"
        config AXP202_DCDC3_VOLTAGE_BIT60_2V6
            bool "2.6V"
        config AXP202_DCDC3_VOLTAGE_BIT60_2V7
            bool "2.7V"
        config AXP202_DCDC3_VOLTAGE_BIT60_2V8
            bool "2.8V"
        config AXP202_DCDC3_VOLTAGE_BIT60_2V9
            bool "2.9V"
        config AXP202_DCDC3_VOLTAGE_BIT60_3V0
            bool "3.0V"
        config AXP202_DCDC3_VOLTAGE_BIT60_3V1
            bool "3.1V"
        config AXP202_DCDC3_VOLTAGE_BIT60_3V2
            bool "3.2V"
        config AXP202_DCDC3_VOLTAGE_BIT60_3V3
            bool "3.3V"
        config AXP202_DCDC3_VOLTAGE_BIT60_3V4
            bool "3.4V"
        config AXP202_DCDC3_VOLTAGE_BIT60_3V5
            bool "3.5V"
    endchoice

    config AXP202_DCDC3_VOLTAGE_BIT60
        hex
        default 0x00 if AXP202_DCDC3_VOLTAGE_BIT60_0V7
        default 0x04 if AXP202_DCDC3_VOLTAGE_BIT60_0V8
        default 0x08 if AXP202_DCDC3_VOLTAGE_BIT60_0V9
        default 0x0c if AXP202_DCDC3_VOLTAGE_BIT60_1V0
        default 0x10 if AXP202_DCDC3_VOLTAGE_BIT60_1V1
        default 0x14 if AXP202_DCDC3_VOLTAGE_BIT60_1V2
        default 0x18 if AXP202_DCDC3_VOLTAGE_BIT60_1V3
        default 0x1c if AXP202_DCDC3_VOLTAGE_BIT60_1V4
        default 0x20 if AXP202_DCDC3_VOLTAGE_BIT60_1V5
        default 0x24 if AXP202_DCDC3_VOLTAGE_BIT60_1V6
        default 0x28 if AXP202_DCDC3_VOLTAGE_BIT60_1V7
        default 0x2c if AXP202_DCDC3_VOLTAGE_BIT60_1V8
        default 0x30 if AXP202_DCDC3_VOLTAGE_BIT60_1V9
        default 0x34 if AXP202_DCDC3_VOLTAGE_BIT60_2V0
        default 0x38 if AXP202_DCDC3_VOLTAGE_BIT60_2V1
        default 0x3c if AXP202_DCDC3_VOLTAGE_BIT60_2V2
        default 0x40 if AXP202_DCDC3_VOLTAGE_BIT60_2V3
        default 0x44 if AXP202_DCDC3_VOLTAGE_BIT60_2V4
        default 0x48 if AXP202_DCDC3_VOLTAGE_BIT60_2V5
        default 0x4c if AXP202_DCDC3_VOLTAGE_BIT60_2V6
        default 0x50 if AXP202_DCDC3_VOLTAGE_BIT60_2V7
        default 0x54 if AXP202_DCDC3_VOLTAGE_BIT60_2V8
        default 0x58 if AXP202_DCDC3_VOLTAGE_BIT60_2V9
        default 0x5c if AXP202_DCDC3_VOLTAGE_BIT60_3V0
        default 0x60 if AXP202_DCDC3_VOLTAGE_BIT60_3V1
        default 0x64 if AXP202_DCDC3_VOLTAGE_BIT60_3V2
        default 0x68 if AXP202_DCDC3_VOLTAGE_BIT60_3V3
        default 0x6c if AXP202_DCDC3_VOLTAGE_BIT60_3V4
        default 0x70 if AXP202_DCDC3_VOLTAGE_BIT60_3V5

    choice AXP202_LDO24_VOLTAGE_BIT74
        prompt "LDO2 output voltage"
        default AXP202_LDO24_VOLTAGE_BIT74_3V0
        config AXP202_LDO24_VOLTAGE_BIT74_1V8
            bool "1.8V"
        config AXP202_LDO24_VOLTAGE_BIT74_1V9
            bool "1.9V"
        config AXP202_LDO24_VOLTAGE_BIT74_2V0
            bool "2.0V"
        config AXP202_LDO24_VOLTAGE_BIT74_2V1
            bool "2.1V"
        config AXP202_LDO24_VOLTAGE_BIT74_2V2
            bool "2.2V"
        config AXP202_LDO24_VOLTAGE_BIT74_2V3
            bool "2.3V"
        config AXP202_LDO24_VOLTAGE_BIT74_2V3
            bool "2.4V"
        config AXP202_LDO24_VOLTAGE_BIT74_2V4
            bool "2.5V"
        config AXP202_LDO24_VOLTAGE_BIT74_2V5
            bool "2.6V"
        config AXP202_LDO24_VOLTAGE_BIT74_2V6
            bool "2.6V"
        config AXP202_LDO24_VOLTAGE_BIT74_2V7
            bool "2.7V"
        config AXP202_LDO24_VOLTAGE_BIT74_2V8
            bool "2.8V"
        config AXP202_LDO24_VOLTAGE_BIT74_2V9
            bool "2.9V"
        config AXP202_LDO24_VOLTAGE_BIT74_3V0
            bool "3.0V"
        config AXP202_LDO24_VOLTAGE_BIT74_3V1
            bool "3.1V"
        config AXP202_LDO24_VOLTAGE_BIT74_3V2
            bool "3.2V"
        config AXP202_LDO24_VOLTAGE_BIT74_3V3
            bool "3.3V"
    endchoice

    config AXP202_LDO24_VOLTAGE_BIT74
        hex
        default 0x00 if AXP202_LDO24_VOLTAGE_BIT74_1V8
        default 0x10 if AXP202_LDO24_VOLTAGE_BIT74_1V9
        default 0x20 if AXP202_LDO24_VOLTAGE_BIT74_2V0
        default 0x30 if AXP202_LDO24_VOLTAGE_BIT74_2V1
        default 0x40 if AXP202_LDO24_VOLTAGE_BIT74_2V2
        default 0x50 if AXP202_LDO24_VOLTAGE_BIT74_2V3
        default 0x60 if AXP202_LDO24_VOLTAGE_BIT74_2V4
        default 0x70 if AXP202_LDO24_VOLTAGE_BIT74_2V5
        default 0x80 if AXP202_LDO24_VOLTAGE_BIT74_2V6
        default 0x90 if AXP202_LDO24_VOLTAGE_BIT74_2V7
        default 0xa0 if AXP202_LDO24_VOLTAGE_BIT74_2V8
        default 0xb0 if AXP202_LDO24_VOLTAGE_BIT74_2V9
        default 0xc0 if AXP202_LDO24_VOLTAGE_BIT74_3V0
        default 0xd0 if AXP202_LDO24_VOLTAGE_BIT74_3V1
        default 0xe0 if AXP202_LDO24_VOLTAGE_BIT74_3V2
        default 0xf0 if AXP202_LDO24_VOLTAGE_BIT74_3V3

    choice AXP202_LDO24_VOLTAGE_BIT30
        prompt "LDO4 output voltage"
        default AXP202_LDO24_VOLTAGE_BIT30_3V0
        config AXP202_LDO24_VOLTAGE_BIT30_1V25
            bool "1.25V"
        config AXP202_LDO24_VOLTAGE_BIT30_1V3
            bool "1.3V"
        config AXP202_LDO24_VOLTAGE_BIT30_1V4
            bool "1.4V"
        config AXP202_LDO24_VOLTAGE_BIT30_1V5
            bool "1.5V"
        config AXP202_LDO24_VOLTAGE_BIT30_1V6
            bool "1.6V"
        config AXP202_LDO24_VOLTAGE_BIT30_1V7
            bool "1.7V"
        config AXP202_LDO24_VOLTAGE_BIT30_1V8
            bool "1.8V"
        config AXP202_LDO24_VOLTAGE_BIT30_1V9
            bool "1.9V"
        config AXP202_LDO24_VOLTAGE_BIT30_2V0
            bool "2.0V"
        config AXP202_LDO24_VOLTAGE_BIT30_2V5
            bool "2.5V"
        config AXP202_LDO24_VOLTAGE_BIT30_2V7
            bool "2.7V"
        config AXP202_LDO24_VOLTAGE_BIT30_2V8
            bool "2.8V"
        config AXP202_LDO24_VOLTAGE_BIT30_3V0
            bool "3.0V"
        config AXP202_LDO24_VOLTAGE_BIT30_3V1
            bool "3.1V"
        config AXP202_LDO24_VOLTAGE_BIT30_3V2
            bool "3.2V"
        config AXP202_LDO24_VOLTAGE_BIT30_3V3
            bool "3.3V"
    endchoice

    config AXP202_LDO24_VOLTAGE_BIT30
        hex
        default 0x01 if AXP202_LDO24_VOLTAGE_BIT30_1V25
        default 0x02 if AXP202_LDO24_VOLTAGE_BIT30_1V3
        default 0x03 if AXP202_LDO24_VOLTAGE_BIT30_1V4
        default 0x04 if AXP202_LDO24_VOLTAGE_BIT30_1V5
        default 0x05 if AXP202_LDO24_VOLTAGE_BIT30_1V6
        default 0x06 if AXP202_LDO24_VOLTAGE_BIT30_1V7
        default 0x07 if AXP202_LDO24_VOLTAGE_BIT30_1V8
        default 0x08 if AXP202_LDO24_VOLTAGE_BIT30_1V9
        default 0x09 if AXP202_LDO24_VOLTAGE_BIT30_2V0
        default 0x0a if AXP202_LDO24_VOLTAGE_BIT30_2V5
        default 0x0b if AXP202_LDO24_VOLTAGE_BIT30_2V6
        default 0x0c if AXP202_LDO24_VOLTAGE_BIT30_2V8
        default 0x0d if AXP202_LDO24_VOLTAGE_BIT30_3V0
        default 0x0e if AXP202_LDO24_VOLTAGE_BIT30_3V1
        default 0x0f if AXP202_LDO24_VOLTAGE_BIT30_3V2
        default 0x10 if AXP202_LDO24_VOLTAGE_BIT30_3V3

    choice AXP202_LDO3_VOLTAGE_BIT60
        prompt "LDO3 output voltage"
        default AXP202_LDO3_VOLTAGE_BIT60_3V0
        config AXP202_LDO3_VOLTAGE_BIT60_0V7
            bool "0.7V"
        config AXP202_LDO3_VOLTAGE_BIT60_0V8
            bool "0.8V"
        config AXP202_LDO3_VOLTAGE_BIT60_0V9
            bool "0.9V"
        config AXP202_LDO3_VOLTAGE_BIT60_1V0
            bool "1.0V"
        config AXP202_LDO3_VOLTAGE_BIT60_1V1
            bool "1.1V"
        config AXP202_LDO3_VOLTAGE_BIT60_1V2
            bool "1.2V"
        config AXP202_LDO3_VOLTAGE_BIT60_1V3
            bool "1.3V"
        config AXP202_LDO3_VOLTAGE_BIT60_1V4
            bool "1.4V"
        config AXP202_LDO3_VOLTAGE_BIT60_1V5
            bool "1.5V"
        config AXP202_LDO3_VOLTAGE_BIT60_1V6
            bool "1.6V"
        config AXP202_LDO3_VOLTAGE_BIT60_1V7
            bool "1.7V"
        config AXP202_LDO3_VOLTAGE_BIT60_1V8
            bool "1.8V"
        config AXP202_LDO3_VOLTAGE_BIT60_1V9
            bool "1.9V"
        config AXP202_LDO3_VOLTAGE_BIT60_2V0
            bool "2.0V"
        config AXP202_LDO3_VOLTAGE_BIT60_2V1
            bool "2.1V"
        config AXP202_LDO3_VOLTAGE_BIT60_2V2
            bool "2.2V"
        config AXP202_LDO3_VOLTAGE_BIT60_2V3
            bool "2.3V"
        config AXP202_LDO3_VOLTAGE_BIT60_2V3
            bool "2.4V"
        config AXP202_LDO3_VOLTAGE_BIT60_2V4
            bool "2.5V"
        config AXP202_LDO3_VOLTAGE_BIT60_2V5
            bool "2.6V"
        config AXP202_LDO3_VOLTAGE_BIT60_2V6
            bool "2.6V"
        config AXP202_LDO3_VOLTAGE_BIT60_2V7
            bool "2.7V"
        config AXP202_LDO3_VOLTAGE_BIT60_2V8
            bool "2.8V"
        config AXP202_LDO3_VOLTAGE_BIT60_2V9
            bool "2.9V"
        config AXP202_LDO3_VOLTAGE_BIT60_3V0
            bool "3.0V"
        config AXP202_LDO3_VOLTAGE_BIT60_3V1
            bool "3.1V"
        config AXP202_LDO3_VOLTAGE_BIT60_3V2
            bool "3.2V"
        config AXP202_LDO3_VOLTAGE_BIT60_3V3
            bool "3.3V"
        config AXP202_LDO3_VOLTAGE_BIT60_3V4
            bool "3.4V"
        config AXP202_LDO3_VOLTAGE_BIT60_3V5
            bool "3.5V"
    endchoice

    config AXP202_LDO3_VOLTAGE_BIT60
        hex
        default 0x00 if AXP202_LDO3_VOLTAGE_BIT60_0V7
        default 0x04 if AXP202_LDO3_VOLTAGE_BIT60_0V8
        default 0x08 if AXP202_LDO3_VOLTAGE_BIT60_0V9
        default 0x0c if AXP202_LDO3_VOLTAGE_BIT60_1V0
        default 0x10 if AXP202_LDO3_VOLTAGE_BIT60_1V1
        default 0x14 if AXP202_LDO3_VOLTAGE_BIT60_1V2
        default 0x18 if AXP202_LDO3_VOLTAGE_BIT60_1V3
        default 0x1c if AXP202_LDO3_VOLTAGE_BIT60_1V4
        default 0x20 if AXP202_LDO3_VOLTAGE_BIT60_1V5
        default 0x24 if AXP202_LDO3_VOLTAGE_BIT60_1V6
        default 0x28 if AXP202_LDO3_VOLTAGE_BIT60_1V7
        default 0x2c if AXP202_LDO3_VOLTAGE_BIT60_1V8
        default 0x30 if AXP202_LDO3_VOLTAGE_BIT60_1V9
        default 0x34 if AXP202_LDO3_VOLTAGE_BIT60_2V0
        default 0x38 if AXP202_LDO3_VOLTAGE_BIT60_2V1
        default 0x3c if AXP202_LDO3_VOLTAGE_BIT60_2V2
        default 0x40 if AXP202_LDO3_VOLTAGE_BIT60_2V3
        default 0x44 if AXP202_LDO3_VOLTAGE_BIT60_2V4
        default 0x48 if AXP202_LDO3_VOLTAGE_BIT60_2V5
        default 0x4c if AXP202_LDO3_VOLTAGE_BIT60_2V6
        default 0x50 if AXP202_LDO3_VOLTAGE_BIT60_2V7
        default 0x54 if AXP202_LDO3_VOLTAGE_BIT60_2V8
        default 0x58 if AXP202_LDO3_VOLTAGE_BIT60_2V9
        default 0x5c if AXP202_LDO3_VOLTAGE_BIT60_3V0
        default 0x60 if AXP202_LDO3_VOLTAGE_BIT60_3V1
        default 0x64 if AXP202_LDO3_VOLTAGE_BIT60_3V2
        default 0x68 if AXP202_LDO3_VOLTAGE_BIT60_3V3
        default 0x6c if AXP202_LDO3_VOLTAGE_BIT60_3V4
        default 0x70 if AXP202_LDO3_VOLTAGE_BIT60_3V5

endmenu

menu "ADC control"
    config AXP202_ADC_ENABLE_1_BIT7_SELECTED
        bool "Enable BAT boltage ADC"
    config AXP202_ADC_ENABLE_1_BIT6_SELECTED
        bool "Enable BAT current ADC"
    config AXP202_ADC_ENABLE_1_BIT5_SELECTED
        bool "Enable ACIN voltage ADC"
    config AXP202_ADC_ENABLE_1_BIT4_SELECTED
        bool "Enable ACIN current ADC"
    config AXP202_ADC_ENABLE_1_BIT3_SELECTED
        bool "Enable VBUS voltage ADC"
    config AXP202_ADC_ENABLE_1_BIT2_SELECTED
        bool "Enable VBUS current ADC"
    config AXP202_ADC_ENABLE_1_BIT1_SELECTED
        bool "Enable APS voltage ADC"
    config AXP202_ADC_ENABLE_1_BIT0_SELECTED
        bool "Enable TS ADC"

    config AXP202_ADC_ENABLE_2_BIT7_SELECTED
        bool "Enable internal temperature ADC"
    config AXP202_ADC_ENABLE_2_BIT3_SELECTED
        bool "Enable GPIO0 ADC"
    config AXP202_ADC_ENABLE_2_BIT2_SELECTED
        bool "Enable GPIO1 ADC"
endmenu

config AXP202_ADC_ENABLE_1_BIT7
    hex
    default 0x00 if !AXP202_ADC_ENABLE_1_BIT7_SELECTED
    default 0x80 if AXP202_ADC_ENABLE_1_BIT7_SELECTED

config AXP202_ADC_ENABLE_1_BIT6
    hex
    default 0x00 if !AXP202_ADC_ENABLE_1_BIT6_SELECTED
    default 0x40 if AXP202_ADC_ENABLE_1_BIT6_SELECTED

config AXP202_ADC_ENABLE_1_BIT5
    hex
    default 0x00 if !AXP202_ADC_ENABLE_1_BIT5_SELECTED
    default 0x20 if AXP202_ADC_ENABLE_1_BIT5_SELECTED

config AXP202_ADC_ENABLE_1_BIT4
    hex
    default 0x00 if !AXP202_ADC_ENABLE_1_BIT4_SELECTED
    default 0x10 if AXP202_ADC_ENABLE_1_BIT4_SELECTED

config AXP202_ADC_ENABLE_1_BIT3
    hex
    default 0x00 if !AXP202_ADC_ENABLE_1_BIT3_SELECTED
    default 0x08 if AXP202_ADC_ENABLE_1_BIT3_SELECTED

config AXP202_ADC_ENABLE_1_BIT2
    hex
    default 0x00 if !AXP202_ADC_ENABLE_1_BIT2_SELECTED
    default 0x04 if AXP202_ADC_ENABLE_1_BIT2_SELECTED

config AXP202_ADC_ENABLE_1_BIT1
    hex
    default 0x00 if !AXP202_ADC_ENABLE_1_BIT1_SELECTED
    default 0x02 if AXP202_ADC_ENABLE_1_BIT1_SELECTED

config AXP202_ADC_ENABLE_1_BIT0
    hex
    default 0x00 if !AXP202_ADC_ENABLE_1_BIT0_SELECTED
    default 0x01 if AXP202_ADC_ENABLE_1_BIT0_SELECTED

config AXP202_ADC_ENABLE_2_BIT7
    hex
    default 0x00 if !AXP202_ADC_ENABLE_1_BIT7_SELECTED
    default 0x80 if AXP202_ADC_ENABLE_1_BIT7_SELECTED

config AXP202_ADC_ENABLE_2_BIT3
    hex
    default 0x00 if !AXP202_ADC_ENABLE_1_BIT3_SELECTED
    default 0x08 if AXP202_ADC_ENABLE_1_BIT3_SELECTED

config AXP202_ADC_ENABLE_2_BIT2
    hex
    default 0x00 if !AXP202_ADC_ENABLE_1_BIT2_SELECTED
    default 0x04 if AXP202_ADC_ENABLE_1_BIT2_SELECTED

endmenu
```
